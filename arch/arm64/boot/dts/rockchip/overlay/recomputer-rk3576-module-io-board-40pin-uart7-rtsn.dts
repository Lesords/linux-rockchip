// SPDX-License-Identifier: (GPL-2.0+ OR MIT)
/*
 * 40PIN UART7 hardware flow control: adds RTSn on pin 35
 * (xfer on pin 29/31 and CTSn on pin 37 are already enabled in base DTS)
 */

/dts-v1/;
/plugin/;
#include <dt-bindings/pinctrl/rockchip.h>
#include <dt-bindings/gpio/gpio.h>

/ {
	fragment@0 {
		target = <&uart7>;

		__overlay__ {
			status = "okay";
			pinctrl-names = "default";
			pinctrl-0 = <&uart7m0_xfer &uart7m0_ctsn &uart7m0_rtsn>;
		};
	};
};
