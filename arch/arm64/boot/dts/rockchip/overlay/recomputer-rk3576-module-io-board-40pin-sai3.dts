// SPDX-License-Identifier: (GPL-2.0+ OR MIT)
/*
 * 40PIN SAI3 (M2) I2S: pin 7 (SCLK), pin 12 (MCLK), pin 15 (SDO),
 * pin 22 (LRCK), pin 36 (SDI)
 */

/dts-v1/;
/plugin/;
#include <dt-bindings/pinctrl/rockchip.h>
#include <dt-bindings/gpio/gpio.h>

/ {
	fragment@0 {
		target = <&sai3>;

		__overlay__ {
			status = "okay";
			rockchip,sai-rx-route = <0 1 2 3>;
			rockchip,sai-tx-route = <0 1 2 3>;
			pinctrl-names = "default";
			pinctrl-0 = <&sai3m2_mclk
				     &sai3m2_sclk
				     &sai3m2_lrck
				     &sai3m2_sdo
				     &sai3m2_sdi>;
		};
	};
};
