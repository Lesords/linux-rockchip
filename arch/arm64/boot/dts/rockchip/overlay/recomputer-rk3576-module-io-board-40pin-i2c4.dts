// SPDX-License-Identifier: (GPL-2.0+ OR MIT)
/*
 * 40PIN I2C4 (M1): pin 38 (SCL), pin 40 (SDA)
 * Mutually exclusive with: 40pin-can0, 40pin-uart6
 */

/dts-v1/;
/plugin/;
#include <dt-bindings/pinctrl/rockchip.h>
#include <dt-bindings/gpio/gpio.h>

/ {
	fragment@0 {
		target = <&i2c4>;

		__overlay__ {
			status = "okay";
			pinctrl-names = "default";
			pinctrl-0 = <&i2c4m1_xfer>;
		};
	};
};
