// SPDX-License-Identifier: (GPL-2.0+ OR MIT)
/*
 * 40PIN CAN0 (M2): pin 38 (TX), pin 40 (RX)
 */

/dts-v1/;
/plugin/;
#include <dt-bindings/pinctrl/rockchip.h>
#include <dt-bindings/gpio/gpio.h>

/ {
	fragment@0 {
		target = <&can0>;

		__overlay__ {
			status = "okay";
			pinctrl-names = "default";
			pinctrl-0 = <&can0m2_pins>;
		};
	};
};
