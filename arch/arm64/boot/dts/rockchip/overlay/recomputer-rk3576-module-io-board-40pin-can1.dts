// SPDX-License-Identifier: (GPL-2.0+ OR MIT)
/*
 * 40PIN CAN1 (M2): pin 11 (RX), pin 13 (TX)
 */

/dts-v1/;
/plugin/;
#include <dt-bindings/pinctrl/rockchip.h>
#include <dt-bindings/gpio/gpio.h>

/ {
	fragment@0 {
		target = <&can1>;

		__overlay__ {
			status = "okay";
			pinctrl-names = "default";
			pinctrl-0 = <&can1m2_pins>;
		};
	};
};
