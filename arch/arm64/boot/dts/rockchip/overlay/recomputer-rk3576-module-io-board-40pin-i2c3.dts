// SPDX-License-Identifier: (GPL-2.0+ OR MIT)
/* 40PIN I2C3 (M1): pin 3 (SDA), pin 5 (SCL) */

/dts-v1/;
/plugin/;
#include <dt-bindings/pinctrl/rockchip.h>
#include <dt-bindings/gpio/gpio.h>

/ {
	fragment@0 {
		target = <&i2c3>;

		__overlay__ {
			status = "okay";
			pinctrl-names = "default";
			pinctrl-0 = <&i2c3m1_xfer>;
		};
	};
};
