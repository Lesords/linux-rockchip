// SPDX-License-Identifier: (GPL-2.0+ OR MIT)
/* 40PIN UART7 (M0): pin 29 (TX), pin 31 (RX) */

/dts-v1/;
/plugin/;
#include <dt-bindings/pinctrl/rockchip.h>
#include <dt-bindings/gpio/gpio.h>

/ {
	fragment@0 {
		target = <&uart7>;

		__overlay__ {
			status = "okay";
			pinctrl-names = "default";
			pinctrl-0 = <&uart7m0_xfer>;
		};
	};
};
