// SPDX-License-Identifier: (GPL-2.0+ OR MIT)
/*
 * 40PIN CAN1 (M3): pin 36 (RX), pin 15 (TX)
 * Mutually exclusive with: 40pin-spi3, 40pin-sai3, 40pin-uart3,
 * 40pin-can1 (M2, pins 11/13)
 */

/dts-v1/;
/plugin/;
#include <dt-bindings/pinctrl/rockchip.h>
#include <dt-bindings/gpio/gpio.h>

/ {
	fragment@0 {
		target = <&can1>;

		__overlay__ {
			status = "okay";
			pinctrl-names = "default";
			pinctrl-0 = <&can1m3_pins>;
		};
	};
};
