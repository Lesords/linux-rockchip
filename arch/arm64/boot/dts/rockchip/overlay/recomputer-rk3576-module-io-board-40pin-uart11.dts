// SPDX-License-Identifier: (GPL-2.0+ OR MIT)
/* 40PIN UART11 (M1): pin 24 (TX), pin 23 (RX) */

/dts-v1/;
/plugin/;
#include <dt-bindings/pinctrl/rockchip.h>
#include <dt-bindings/gpio/gpio.h>

/ {
	fragment@0 {
		target = <&uart11>;

		__overlay__ {
			status = "okay";
			pinctrl-names = "default";
			pinctrl-0 = <&uart11m1_xfer>;
		};
	};
};
