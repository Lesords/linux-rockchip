// SPDX-License-Identifier: (GPL-2.0+ OR MIT)
/* 40PIN UART3 (M0): pin 7 (TX), pin 22 (RX) */

/dts-v1/;
/plugin/;
#include <dt-bindings/pinctrl/rockchip.h>
#include <dt-bindings/gpio/gpio.h>

/ {
	fragment@0 {
		target = <&uart3>;

		__overlay__ {
			status = "okay";
			pinctrl-names = "default";
			pinctrl-0 = <&uart3m0_xfer>;
		};
	};
};
