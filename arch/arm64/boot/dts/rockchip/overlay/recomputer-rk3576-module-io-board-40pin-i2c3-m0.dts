// SPDX-License-Identifier: (GPL-2.0+ OR MIT)
/*
 * 40PIN I2C3 (M0): pin 11 (SDA), pin 13 (SCL)
 * Switch variant: same controller as 40pin-i2c3 (M1, pins 3/5) —
 * load one or the other, not both.
 * Mutually exclusive with: 40pin-can1, 40pin-uart2
 */

/dts-v1/;
/plugin/;
#include <dt-bindings/pinctrl/rockchip.h>
#include <dt-bindings/gpio/gpio.h>

/ {
	fragment@0 {
		target = <&i2c3>;

		__overlay__ {
			status = "okay";
			pinctrl-names = "default";
			pinctrl-0 = <&i2c3m0_xfer>;
		};
	};
};
