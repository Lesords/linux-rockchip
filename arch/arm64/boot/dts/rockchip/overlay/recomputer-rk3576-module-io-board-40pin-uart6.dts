// SPDX-License-Identifier: (GPL-2.0+ OR MIT)
/* 40PIN UART6 (M0): pin 38 (TX), pin 40 (RX) */

/dts-v1/;
/plugin/;
#include <dt-bindings/pinctrl/rockchip.h>
#include <dt-bindings/gpio/gpio.h>

/ {
	fragment@0 {
		target = <&uart6>;

		__overlay__ {
			status = "okay";
			pinctrl-names = "default";
			pinctrl-0 = <&uart6m0_xfer>;
		};
	};
};
