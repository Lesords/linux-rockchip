// SPDX-License-Identifier: (GPL-2.0+ OR MIT)
/* 40PIN PWM1 CH1 (M2): pin 26 */

/dts-v1/;
/plugin/;
#include <dt-bindings/pinctrl/rockchip.h>
#include <dt-bindings/gpio/gpio.h>

/ {
	fragment@0 {
		target = <&pwm1_6ch_1>;

		__overlay__ {
			status = "okay";
			pinctrl-names = "active";
			pinctrl-0 = <&pwm1m2_ch1>;
		};
	};
};
